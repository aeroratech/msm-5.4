## drivers/net/ethernet/realtek/r8168/Kconfig
```kconfig
# SPDX-License-Identifier: GPL-2.0-only
#
# Realtek device configuration
#

config NET_VENDOR_REALTEK
	bool "Realtek devices"
	default y
	depends on PCI || (PARPORT && X86)
	---help---
	  If you have a network (Ethernet) card belonging to this class, say Y.

	  Note that the answer to this question doesn't directly affect the
	  kernel: saying N will just cause the configurator to skip all
	  the questions about Realtek devices. If you say Y, you will be asked for
	  your specific card in the following questions.

if NET_VENDOR_REALTEK

config R8168
	tristate "Realtek 8168 ethernet support"
	default n if R8169
	depends on PCI
	---help---
	   Say Y here if you have a Realtek Ethernet adapter belonging to
	   the following families:
	   RTL8168 Gigabit Ethernet

	   To compile this driver as a module, choose M here: the module
	   will be called r8168.  This is recommended.

endif #NET_VENDOR_REALTEK
```

## vendor/qcom/proprietary/devicetree/bindings/input/sensors/smi230.txt
```
The SMI230 is a highly integrated, low power inertial measurement unit (IMU)
that provides precise acceleration and angular rate (gyroscopic) measurement.

To enable driver probing, add the smi230_gyro and smi230_acc node to the platform
device tree as described below.

Required properties:

- compatible: "SMI230ACC", "SMI230GYRO"
- reg: the I2C address or SPI chip select the device will respond to
- interrupt-parent: phandle to the parent interrupt controller as documented in [interrupts][4]
- interrupts: interrupt mapping for IRQ as documented in [interrupts][4]

Recommended properties for SPI bus usage:
- spi-max-frequency: maximum SPI bus frequency as documented in [SPI][3]

Optional properties:
- smi230_gyro,gpio_irq: MEMS sensor interrupt line to use (default 1)

I2C example (based on Raspberry PI 3):

        &i2c0 {
                status = "ok";
                #address-cells = <0x1>;
                #size-cells = <0x0>;
                smi230_gyro@68 {
                        compatible = "SMI230GYRO";
                        reg = <0x68>;
                        interrupt-parent = <&gpio>;
                        interrupts = <26 IRQ_TYPE_EDGE_RISING>;
                };
                smi230_acc@18 {
                        compatible = "SMI230ACC";
                        reg = <0x18>;
                        interrupt-parent = <&gpio>;
                        interrupts = <25 IRQ_TYPE_EDGE_RISING>;
                };

SPI example (based on Raspberry PI 3):

        &spi0 {
                status = "ok";
                #address-cells = <0x1>;
                #size-cells = <0x0>;
                smi230_gyro@68 {
                        compatible = "SMI230GYRO";
                        reg = <0x68>;
                        interrupt-parent = <&gpio>;
                        interrupts = <26 IRQ_TYPE_EDGE_RISING>;
                };
                smi230_acc@18 {
                        compatible = "SMI230ACC";
                        reg = <0x18>;
                        interrupt-parent = <&gpio>;
                        interrupts = <25 IRQ_TYPE_EDGE_RISING>;
                };
```

## vendor/qcom/proprietary/devicetree/bindings/interconnect/qcom,sdxpoorwills.txt
```
Qualcomm Technologies, Inc. SDXPOORWILLS Network-On-Chip interconnect driver binding
--------------------------------------------------------------------------------

SDXPOORWILLS interconnect providers support system bandwidth requirements through
RPMh hardware accelerators known as Bus Clock Manager (BCM). The provider is
able to communicate with the BCM through the Resource State Coordinator (RSC)
associated with each execution environment. Provider nodes must point to at
least one RPMh device child node pertaining to their RSC and each provider
can map to multiple RPMh resources.

Required properties :
- compatible : shall contain only one of the following:
			"qcom,sdxpoorwills-ipa_virt",
			"qcom,sdxpoorwills-system_noc",
			"qcom,sdxpoorwills-mem_noc",
			"qcom,sdxpoorwills-mc_virt",
- #interconnect-cells : should contain 1

Examples:

system_noc: interconnect@1620000 {
	compatible = "qcom,sdxpoorwills-system_noc";
	interconnect-cells = <1>;
};
```

## vendor/qcom/proprietary/devicetree/bindings/smcinvoke/smcinvoke.txt
```
* SMCInvoke driver to provide transport between TZ and Linux

Required properties:
- compatible : Should be "qcom,smcinvoke"
- qcom,support-legacy_smc : indicates that secure side uses QCOM_SCM_SMCINVOKE_INVOKE_LEGACY (value = 0x00) for smcinvoke
			    functionality.
- qcom,clock-support : indicates that clock support is enabled for smcinvoke

Example:
	qcom_smcinvoke: smcinvoke@87900000 {
		compatible = "qcom,smcinvoke";
	};

Example: For targets where secure side runs with QCOM_SCM_SMCINVOKE_INVOKE_LEGACY cmd id
	qcom_smcinvoke: smcinvoke@87900000 {
                compatible = "qcom,smcinvoke";
		qcom,support-legacy_smc;
        };

Example: For targets where clock support is present for smcinvoke
	qcom_smcinvoke: smcinvoke@88000000 {
		compatible = "qcom,smcinvoke";
		qcom,clock-support;
	};
```
